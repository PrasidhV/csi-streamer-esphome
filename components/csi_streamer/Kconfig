## components/csi_streamer/Kconfig
```kconfig
config ESP_WIFI_RX_BA_WIN
	int "WiFi RX BA window size"
	default 4
	help
	  WiFi RX Block Acknowledgment window size.
```

## components/csi_streamer/sdkconfig.defaults
```kconfig
# Fix ESP-IDF 5.5.4 missing defines
CONFIG_ESP_WIFI_RX_BA_WIN=4
CONFIG_ESP_WIFI_RX_IRAM_OPT=y

# Enable PM module (required for freertos_hooks.c - esp_pm_impl_idle_hook)
CONFIG_PM_ENABLE=y
```
